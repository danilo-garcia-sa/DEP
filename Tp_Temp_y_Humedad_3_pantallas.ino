/*
 * ====================================================================
 * Este programa lee la temperatura y humedad desde un sensor DHT22,
 * junto con la presión atmosférica desde un sensor BMP280.
 * Utiliza un botón físico para alternar cíclicamente entre 3 pantallas 
 * en un display OLED de 128x64 píxeles:
 * - Pantalla 1: Ícono de termómetro y temperatura (°C).
 * - Pantalla 2: Ícono de gota y humedad relativa (%).
 * - Pantalla 3: Ícono de barómetro y presión atmosférica (hPa).
 * ====================================================================
 */

//#include <Adafruit_BMP085.h>
//#include <SPI.h>
#include <Wire.h>
#include <Adafruit_GFX.h>
#include <Adafruit_SSD1306.h>
#include <DHT.h>
#include <Adafruit_BMP280.h>

Adafruit_BMP280 bmp;

#define DHTPIN 19
#define DHTTYPE    DHT22

#define SCREEN_WIDTH 128 // OLED display width, in pixels
#define SCREEN_HEIGHT 64 // OLED display height, in pixels

#define OLED_RESET     -1 // Reset pin # (or -1 if sharing Arduino reset pin)
#define SCREEN_ADDRESS 0x3C ///< See datasheet for Address; 0x3D for 128x64, 0x3C for 128x32
Adafruit_SSD1306 display(SCREEN_WIDTH, SCREEN_HEIGHT, &Wire, OLED_RESET);

const unsigned char bmp_icons8_term_metro_64 [] PROGMEM = {
	0x00, 0x00, 0x00, 0x00, 0x00, 0x00, 0x00, 0x00, 0x00, 0x00, 0x00, 0x00, 0x00, 0x00, 0x00, 0x00, 
	0x00, 0x00, 0x00, 0x00, 0x00, 0x00, 0x00, 0x00, 0x00, 0x00, 0x00, 0x00, 0x00, 0x00, 0x00, 0x00, 
	0x00, 0x00, 0x00, 0x07, 0xe0, 0x00, 0x00, 0x00, 0x00, 0x00, 0x00, 0x1f, 0xf8, 0x00, 0x00, 0x00, 
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	0x00, 0x00, 0x00, 0x00, 0x00, 0x00, 0x00, 0x00, 0x00, 0x00, 0x00, 0x00, 0x00, 0x00, 0x00, 0x00
};

const unsigned char epd_bitmap_agua_64 [] PROGMEM = {
	0x00, 0x00, 0x00, 0x00, 0x00, 0x00, 0x00, 0x00, 0x00, 0x00, 0x00, 0x00, 0x00, 0x00, 0x00, 0x00, 
	0x00, 0x00, 0x00, 0x01, 0x80, 0x00, 0x00, 0x00, 0x00, 0x00, 0x00, 0x03, 0xc0, 0x00, 0x00, 0x00, 
	0x00, 0x00, 0x00, 0x07, 0xe0, 0x00, 0x00, 0x00, 0x00, 0x00, 0x00, 0x0f, 0xf0, 0x00, 0x00, 0x00, 
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	0x00, 0x00, 0x00, 0x00, 0x00, 0x00, 0x00, 0x00, 0x00, 0x00, 0x00, 0x00, 0x00, 0x00, 0x00, 0x00
};

const unsigned char bmp_icons_presion_atmos [] PROGMEM = {
	0x00, 0x00, 0x00, 0x00, 0x00, 0x00, 0x3f, 0xff, 0x00, 0x00, 0x00, 0x00, 0x00, 0x00, 0x3f, 0xff, 
	0x00, 0x00, 0x00, 0x00, 0x00, 0x00, 0x3f, 0xff, 0x00, 0x00, 0x00, 0x00, 0x00, 0x00, 0x00, 0x07, 
	0x00, 0x00, 0x00, 0x00, 0x00, 0x00, 0x00, 0x07, 0x00, 0x00, 0x00, 0x00, 0x00, 0x00, 0x00, 0x07, 
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	0x00, 0x00, 0x00, 0x00, 0x00, 0x00, 0x3f, 0xff, 0x00, 0x00, 0x00, 0x00, 0x00, 0x00, 0x3f, 0xff
};

const int epd_bitmap_allArray_LEN = 1;
const unsigned char* epd_bitmap_allArray[1] = {
	epd_bitmap_agua_64
};

const int pinBoton = 0;
int estadoAnterior = HIGH;
int pantallaActiva = 1;

DHT dht(19, DHT22);

int tempCelsius;
int humedadRelativa;
int presionAtmos;

void setup() {
  Serial.begin(115200);
  display.setTextColor(WHITE, BLACK);
  display.setTextSize(2);
  pinMode(pinBoton, INPUT);
  delay(500);
  
  if(!display.begin(SSD1306_SWITCHCAPVCC, SCREEN_ADDRESS)) {
    Serial.println(F("SSD1306 allocation failed"));
    while (1); 
  }
  
  Serial.println(F("DHTxx test!"));
  dht.begin();
  
  if (!bmp.begin(BMP280_ADDRESS_ALT)) {
    Serial.println("Could not find a valid BMP280 sensor, check wiring!");
    while (1);
  }
}
  
void loop() {    
    presionAtmos = bmp.readPressure(); 
    humedadRelativa = (int) dht.readHumidity();
    tempCelsius = (int) dht.readTemperature();
    
    int estadoPulsador = digitalRead(pinBoton);
    if (estadoPulsador == LOW && estadoAnterior == HIGH)
    {
      if (pantallaActiva == 1){
        pantallaActiva = 2;
      } else if (pantallaActiva == 2) {
        pantallaActiva = 3;
      }
      else{
        pantallaActiva = 1;
      }
    }
    estadoAnterior = estadoPulsador;
    
    if (pantallaActiva == 1 ){
        displayTemperatura();
    }
    else if (pantallaActiva == 2) {
        displayHumedad();
    }
    else{
        displayPresion();
    }
    
    Serial.print("Temperature = ");
    Serial.println(" C");    
    Serial.println();
    delay(50);

    if (isnan(humedadRelativa) || isnan(tempCelsius) ){
      Serial.println(F("Failed to read from DHT sensor!"));
      return;
    }
}

void displayTemperatura() {
  display.clearDisplay();
  display.drawBitmap(0,0, bmp_icons8_term_metro_64,64,64, WHITE);
  display.setCursor(64,24);
  display.print(tempCelsius);
  display.write(0xF7);
  display.print("C");
  display.display();
}

void displayHumedad(){
  display.clearDisplay();
  display.drawBitmap(0,0, epd_bitmap_agua_64,64,64, WHITE);
  display.setCursor(60,24);
  display.print(humedadRelativa);
  display.print("%");
  display.display();
}

void displayPresion(){
  display.clearDisplay();
  display.drawBitmap(0,0, bmp_icons_presion_atmos,64,64, WHITE);
  display.setCursor(70,24);
  display.print(presionAtmos / 100);
  display.setCursor(70,48);
  display.print("HPa");
  display.display();
}